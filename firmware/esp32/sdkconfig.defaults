## firmware/esp32/sdkconfig.defaults
```kconfig
CONFIG_IDF_TARGET="esp32s3"
# ESP32-S3-WROOM-1-N16R8: embedded 8 MB octal PSRAM (AP_3v3).
CONFIG_SPIRAM=y
CONFIG_SPIRAM_MODE_OCT=y
CONFIG_SPIRAM_TYPE_AUTO=y
CONFIG_SPIRAM_SPEED_80M=y
CONFIG_SPIRAM_USE_MALLOC=y
CONFIG_CAMERA_AF_SUPPORT=y
CONFIG_CAMERA_AF_DEFAULT_TIMEOUT_MS=3000
CONFIG_ESPTOOLPY_FLASHSIZE_16MB=y
CONFIG_ESPTOOLPY_FLASHSIZE="16MB"
CONFIG_PARTITION_TABLE_CUSTOM=y
CONFIG_PARTITION_TABLE_CUSTOM_FILENAME="partitions.csv"
CONFIG_PARTITION_TABLE_FILENAME="partitions.csv"
```
